## Kconfig
```kconfig
# ============================================================
# Recollection in-tree behaviors Kconfig
# ============================================================

config ZMK_BEHAVIOR_DRAG_LOCK
    bool "〈Drag Lock〉MB1 トグル behavior"
    default y
    depends on DT_HAS_ZMK_BEHAVIOR_DRAG_LOCK_ENABLED
    help
      Enable the drag-lock toggle behavior. One key tap engages MB1
      hold; another tap releases. Useful for long drags without
      requiring a held button.
```

## config/boards/shields/Recollection/Kconfig.shield
```kconfig
config SHIELD_RECOLLECTION_R
    def_bool $(shields_list_contains,Recollection_R)

config SHIELD_RECOLLECTION_L
    def_bool $(shields_list_contains,Recollection_L)
```

## config/west.yml
```yaml
manifest:
  remotes:
    - name: zmkfirmware
      url-base: https://github.com/zmkfirmware
    - name: eincode0
      url-base: https://github.com/eincode0
    - name: ssbb
      url-base: https://github.com/ssbb
    - name: kot149
      url-base: https://github.com/kot149
    - name: caksoylar
      url-base: https://github.com/caksoylar
    - name: nuovotaka
      url-base: https://github.com/nuovotaka
    - name: badjeff
      url-base: https://github.com/badjeff
    - name: urob                              # ⑦⑧ zmk-helpers / zmk-tri-state
      url-base: https://github.com/urob

  projects:
    - name: zmk
      remote: zmkfirmware
      revision: main
      path: zmk
      import: app/west.yml

    - name: zmk-pmw3610-driver
      remote: eincode0
      revision: ca3d922bbc3578be8a78ef68c3a395e19593ae87
      path: modules/zmk-pmw3610-driver

    - name: zmk-listeners
      remote: ssbb
      revision: v1
      path: modules/zmk-listeners

    - name: zmk-mouse-gesture
      remote: kot149
      revision: v1
      path: modules/zmk-mouse-gesture

    - name: zmk-rgbled-widget
      remote: caksoylar
      revision: main
      path: modules/zmk-rgbled-widget
    - name: zmk-pointing-acceleration-alpha
      remote: nuovotaka
      revision: main
      path: modules/zmk-pointing-acceleration-alpha
    - name: zmk-behavior-insomnia
      remote: badjeff
      revision: main
      path: modules/zmk-behavior-insomnia

    - name: zmk-helpers                       # ⑦ keymap 記述ヘルパーマクロ
      remote: urob
      revision: main
      path: modules/zmk-helpers

    - name: zmk-tri-state                     # ⑧ Swapper（スマート Cmd+Tab）
      remote: urob
      revision: main
      path: modules/zmk-tri-state

    - name: zmk-auto-layer                    # ⑨ Smart Num（数字入力で自動レイヤー）
      remote: urob
      revision: main
      path: modules/zmk-auto-layer

  self:
    path: config
```

## dts/bindings/behaviors/zmk,behavior-drag-lock.yaml
```yaml
description: |
  〈Drag Lock〉— Toggle MB1 hold state with a single key.
  Internal state alternates between two child bindings:
  first tap invokes on-binding (lock), next tap invokes off-binding (release).

compatible: "zmk,behavior-drag-lock"

include: zero_param.yaml

properties:
  on-bindings:
    type: phandle-array
    required: true
    description: Behavior to invoke when locking (e.g. drag_on macro).
  off-bindings:
    type: phandle-array
    required: true
    description: Behavior to invoke when unlocking (e.g. drag_off macro).
```
